## west.yml
```yaml
manifest:
  self:
    west-commands: scripts/west-commands.yml

  remotes:
    - name: zephyrproject-rtos
      url-base: https://github.com/zephyrproject-rtos

  projects:
    - name: zephyr
      remote: zephyrproject-rtos
      revision: v3.5.0
      import:
        # By using name-allowlist we can clone only the modules that are
        # strictly needed by the application.
        name-allowlist:
        # Refer to the link below for more information on the modules:
        # https://docs.zephyrproject.org/latest/develop/manifest/index.html
          - cmsis # required by the ARM port
          - hal_nxp # required by the RT1061 board (NXP based)
          - hal_nordic # required by the custom_plank board (Nordic based)
          - hal_stm32  # required by the Nucleo board (STM32 based)
          - hal_rpi_pico # required by the Raspberry Pi Pico board
          - hal_espressif # required by the ESP32 board (Espressif based)
          - littlefs # required by the Zephyr file system
          - mcuboot # required by the MCUBoot bootloader
          - mbedtls # required by the mbedTLS library
          - net-tools # required by the net-tools module
          - segger # required by the Segger RTT library
          - tinycrypt # required by bootloader
          - zcbor # required by the ZCBOR library
          - canopennode # For basic examples, but will be overridden by our 4.0.0+ module
```
